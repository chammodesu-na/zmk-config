#include <zmk/physical_layouts.dtsi>

/ {
    chosen {
        zmk,kscan = &mock_kscan;
        zmk,physical-layout = &foostan_corne_6col_layout;
    };

    mock_kscan: mock_kscan_0 {
        compatible = "zmk,kscan-mock";
        rows = <0>;
        columns = <0>;
        events = <0>;
    };
};
